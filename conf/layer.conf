## conf/layer.conf
```bitbake
# We have a conf and classes directory, add to BBPATH
BBPATH .= ":${LAYERDIR}"

# We have recipes-* directories, add to BBFILES
BBFILES += "${LAYERDIR}/recipes-*/*/*.bb \
            ${LAYERDIR}/recipes-*/*/*.bbappend"

BBFILE_COLLECTIONS += "meta-agl_quiz"
BBFILE_PATTERN_meta-agl_quiz = "^${LAYERDIR}/"
BBFILE_PRIORITY_meta-agl_quiz = "6"

LAYERDEPENDS_meta-agl_quiz = "core flutter-layer"

LAYERSERIES_COMPAT_meta-agl_quiz = "scarthgap"

require conf/files/packages.inc
```
